## arch/arm64/configs/vendor/zf7-new_defconfig
```kconfig
# basic defconfig is kona-perf_defconfig
# Asus Kona Platform
CONFIG_MACH_ASUS_ZS670KS=y

# DTB Overlay
CONFIG_BUILD_ARM64_DT_OVERLAY=y

# Pstore
CONFIG_PSTORE=y
CONFIG_PSTORE_CONSOLE=y
CONFIG_PSTORE_PMSG=y
CONFIG_PSTORE_RAM=y

# Wlan
CONFIG_QCA_CLD_WLAN=m
CONFIG_QCA_CLD_WLAN_PROFILE="qca6390"
CONFIG_CNSS_QCA6390=y
```
